## components/connectivity/iotkit-embedded-3.0.1/3rdparty/tools/Config.in
```kconfig
mainmenu "Main Menu"
comment "Configure C-SDK for IoT Embedded Devices"

source "tools/menu/Config.infra"
source "tools/menu/Config.dev_sign"
source "tools/menu/Config.mqtt"
source "tools/menu/Config.dynamic_register"
source "tools/menu/Config.dev_model"
source "tools/menu/Config.wrappers"
source "tools/menu/Config.atm"
source "tools/menu/Config.ota"
source "tools/menu/Config.coap"
source "tools/menu/Config.dev_reset"
source "tools/menu/Config.http"
source "tools/menu/Config.http2"
source "tools/menu/Config.wifi_provision"
source "tools/menu/Config.dev_bind"
```

## components/connectivity/qcloud_iot_explorer_ble/samples/esp32/components/qcloud_llsync/Kconfig
```kconfig
menu "QCloud LLSync"
config QCLOUD_LLSYNC_SUPPORT

    bool "QCloud LLSync support."
    default "y"

endmenu
```
